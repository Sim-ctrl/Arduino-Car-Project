
//
//  Bitte zuerst in die anderen "kleineren" Projekte schauen! Das Programm hier besteht
//  aus allen 3 Programmen + Ansteuerung zweier Relais
//


#include <SPI.h>      // Bib fuer NFC
#include <MFRC522.h>  // Bib fuer NFC

#include <U8g2lib.h>  //U8g2lib Bib fuer OLED-Display (vglb mit Adafruit) 
#include <Wire.h>     // beim ESP32 wird diese Zeile nicht benötigt

U8G2_SH1106_128X32_VISIONOX_F_HW_I2C oled(U8G2_R0, /* reset=*/ U8X8_PIN_NONE);
//Je nach größe und art des Displays - ich habe oled Display 16*2 

//Striftzüge und Lader ohne Mitte im Hexadezimalsystem:
const unsigned char epd_bitmap_OhneMotor [] {
  0x00, 0x00, 0x00, 0x00, 0x00, 0x00, 0x00, 0x00, 0x00, 0x00, 0x00, 0x00, 0x00, 0x00, 0x00, 0x00,
  0x00, 0x00, 0x00, 0x00, 0x00, 0x00, 0x00, 0x00, 0x00, 0x00, 0x00, 0x00, 0x00, 0x00, 0x00, 0x00,
  0x00, 0x00, 0x00, 0x00, 0x00, 0x00, 0x00, 0x00, 0x00, 0x00, 0x00, 0x00, 0x00, 0x00, 0x00, 0x00,
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  0x00, 0x00, 0x00, 0x00, 0x00, 0x00, 0x00, 0x00, 0x00, 0x00, 0x00, 0x00, 0x00, 0x00, 0x00, 0x00
};

// '1drehung', 16x9px
const unsigned char epd_bitmap_1drehung []  {
  0x00, 0x80, 0x04, 0x90, 0x02, 0xa0, 0x01, 0xc0, 0x0f, 0xf8, 0x01, 0xc0, 0x02, 0xa0, 0x04, 0x90,
  0x00, 0x80
};
// '2drehung', 16x9px
const unsigned char epd_bitmap_2drehung [] {
  0x00, 0x40, 0x02, 0x40, 0x01, 0x50, 0x0f, 0xe0, 0x03, 0xe0, 0x03, 0xf8, 0x05, 0xc0, 0x01, 0x20,
  0x01, 0x00
};
// '3drehung', 16x9px
const unsigned char epd_bitmap_3drehung [] {
  0x01, 0x00, 0x01, 0x20, 0x05, 0xc0, 0x03, 0xf8, 0x01, 0xe0, 0x0f, 0xe0, 0x01, 0xd0, 0x02, 0x40,
  0x00, 0x40
};

const int epd_bitmap_allArray_LEN = 3; // Die Bilder bestehen aus einer 3er Reihe
const unsigned char* epd_bitmap_allArray[3] = { // Bilder in ein Array packen, zur vereinfachung
  epd_bitmap_1drehung,
  epd_bitmap_2drehung,
  epd_bitmap_3drehung
}; 

int progress = 0;
int frame = 0;//Fuer das durchgehen des Arrays
constexpr uint8_t RST_PIN = D3;     // Configurable, see typical pin layout above
constexpr uint8_t SS_PIN = D4;     // Configurable, see typical pin layout above
MFRC522 rfid(SS_PIN, RST_PIN);      // Instance of the class
MFRC522::MIFARE_Key key;           // Bestandteil fuer NFC Reader 
String tag;   // String wird deklariert

//Um die GPIO3 und GPIO1 Pins nutzen zu können
const int relaisPin1 = 3; // RX-Pin (GPIO 3)
const int relaisPin2 = 1; // TX-Pin (GPIO 1)

void setup() {          // Einmalig ausgeführt (Bei Start des Prg oder betätigen d Reset Btn)
  Serial.begin(9600);   //Fuer den Seriellen Monitor - Debugging
  SPI.begin();          // Init SPI bus
  rfid.PCD_Init();      // Init MFRC522

  oled.begin();           //Methodenaufruf aus der Bib um Display zu starten
  oled.setColorIndex(1);  // Display in Farbmodus setzen ( 1 = schwarz)

  pinMode(relaisPin1, OUTPUT);   //Initialisiere fuer die 2Relais
  pinMode(relaisPin2, OUTPUT);   //Zum öffenen & Schließen 
  digitalWrite(relaisPin1, HIGH); //Dauer-HIGH, damit die Relais keinen strom ziehen
  digitalWrite(relaisPin2, HIGH);
  
}
boolean aufOderZu = false;  // Boolean um zwischen Offenen Türen und Geschlossenen zu untsch 

void loop() { //wiederholt fortlaufend

  //von dem OLED - Programm (Zur Darstellung Bild "WoLambo")
  oled.drawBitmap(0, 0, 128 / 8, 32, epd_bitmap_OhneMotor);
  oled.drawBitmap(103, 11, 16 / 8, 9, epd_bitmap_allArray[frame]);
  oled.sendBuffer();
  frame = frame + 1; //Fuer die Frames
  if (frame > 2 ) {  //des Tourbinenrads
    frame = 0; }

  //Um die UID heraus zu bekommen:  
  if ( ! rfid.PICC_IsNewCardPresent())return;//Wenn keine Karte in sich, dann wiederholen
  if (rfid.PICC_ReadCardSerial()) {
    for (byte i = 0; i < 4; i++) {
      tag += rfid.uid.uidByte[i]; // UID wird im Strng "tag" gespeichert
    }
    
    Serial.println(tag);
    
    if (tag == "45112194"|| tag =="834110153"){ //Wenn die Tag-UID mit einer unseren UIDS
      oled.clear();                             //übereinstimmt, dann: clear das Bild (OLED)
      if(aufOderZu){                            //Wenn Turen geschlossen sind
        digitalWrite(relaisPin1, LOW);          //Mache alle Turen auf
        aufOderZu = !aufOderZu;                 //Mache Variable auf "false" -> Tuer ist auf
        oled.clearBuffer();         
        oled.setFont(u8g2_font_logisoso32_tr);  //Schreibe groß "OFFEN"
        oled.drawStr(0,32,"OFFEN");
        oled.sendBuffer();
        }else{                               //Ansonsten -> Wenn also Turen gerade auf sind
          digitalWrite(relaisPin2, LOW);     // Mache Turen auf
          aufOderZu = !aufOderZu;            //Mache Variable auf "true" -> Tuer ist zu
          oled.clearBuffer();
          oled.setFont(u8g2_font_logisoso32_tr); 
          oled.drawStr(0,32,"Car ZU");            //Schreibe groß "Car ZU"
          oled.sendBuffer();
          }
      delay(500);                                   //Pause 500ms
        digitalWrite(relaisPin1, HIGH);             //Schalte wieder aus, weil Tuer schon bewegt
        digitalWrite(relaisPin2, HIGH); // Relais anschalten, sollte daueran bleiben
      delay(2000);
        oled.clear();                               //Schriftzüge "OFFEN"/ "Car ZU" wegmachen
  delay(100);

//Wieder mit dem Bildchen Wo Lambo weitermachen -> Turen sind gerade offen oder zu
// Relais haben einsatz gehabt, kein Relais aktiv
  
  oled.drawBitmap(0, 0, 128 / 8, 32, epd_bitmap_OhneMotor);
//Methodenaufruf. Bild bei 0,0 starten und dann "epd_bitmap_OhneMotor" laden
  oled.drawBitmap(103, 11, 16 / 8, 9, epd_bitmap_allArray[frame]);
//Methodenaufruf. Weiter rechts starten und dann Bild aus Array Laden   
  oled.sendBuffer();
  delay(100);
  frame = frame + 1;//integer frame wird erhöht (Variable für Bilderarray)
  if (frame > 2) {    //Wenn frame größer als 2
    frame = 0;        // ist dann wird wieder bei 0 gestartet
  }
  
    } // Ende der if(richtieg UID)


    tag = "";  //string wird leer gemacht um zu prüfen ob nochmal was kommt 
    rfid.PICC_HaltA();        //RFID sucht nach neuem Tag
    rfid.PCD_StopCrypto1();  //RFID wird gestoppt
  }
}
